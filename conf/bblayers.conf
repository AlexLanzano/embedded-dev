## conf/bblayers.conf
```bitbake
# LAYER_CONF_VERSION is increased each time build/conf/bblayers.conf
# changes incompatibly
LCONF_VERSION = "7"

BBPATH = "${TOPDIR}:"
BBPATH += "${TOPDIR}/layers/openembedded-core:"
BBPATH += "${TOPDIR}/layers/meta-arm:"
BBPATH += "${TOPDIR}/layers/meta-ti/meta-ti-bsp:"
BBPATH += "${TOPDIR}/layers/meta-freescale:"
BBPATH += "${TOPDIR}/layers/meta-openembedded/meta-multimedia:"
BBPATH += "${TOPDIR}/layers/meta-openembedded/meta-python:"
BBPATH += "${TOPDIR}/layers/meta-openembedded/meta"
BBFILES ?= ""

BBLAYERS ?= " \
  ${TOPDIR}/layers/openembedded-core/meta \
  ${TOPDIR}/layers/meta-arm/meta-arm \
  ${TOPDIR}/layers/meta-arm/meta-arm-bsp \
  ${TOPDIR}/layers/meta-arm/meta-arm-systemready \
  ${TOPDIR}/layers/meta-arm/meta-arm-toolchain \
  ${TOPDIR}/layers/meta-ti/meta-ti-bsp \
  ${TOPDIR}/layers/meta-ti/meta-ti-extras \
  ${TOPDIR}/layers/meta-ti/meta-beagle \
  ${TOPDIR}/layers/meta-embedded-dev \
  ${TOPDIR}/layers/meta-openembedded/meta-oe \
  ${TOPDIR}/layers/meta-freescale \
  ${TOPDIR}/layers/meta-openembedded/meta-multimedia \
  ${TOPDIR}/layers/meta-openembedded/meta-python \
  "
```

## conf/local.conf
```bitbake
EMB_DEV_IPADDR = "192.168.0.20"
EMB_DEV_HOSTIP = "192.168.0.21"
EMB_DEV_NFSROOT = "\/home\/alex\/Repos\/embedded-dev\/nfsroot"

IMAGE_INSTALL:append = "kernel-module-test "
```
